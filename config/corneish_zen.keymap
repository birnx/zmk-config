/* source key position labels */
#include "zmk-helpers/key-labels/42.h"

/* map Zen's extra keys */
#define X_LH  &kp TAB      // thumb row, left
#define X_RH  &smart_shft  // thumb row, right
#define X_LT  &kp ESC
#define X_LM  &kp TAB
#define X_LB  &smart_shft

/* activate bluetooth */
#define CONFIG_WIRELESS 1

/* source the main keymap */
#include "base.keymap"
